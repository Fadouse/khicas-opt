## build/esp32/sdkconfig.defaults
```kconfig
CONFIG_IDF_TARGET="esp32s3"
CONFIG_ESPTOOLPY_FLASHSIZE_4MB=y
CONFIG_PARTITION_TABLE_SINGLE_APP_LARGE=y
CONFIG_FREERTOS_HZ=1000
CONFIG_LWIP_IP_FORWARD=y
CONFIG_LWIP_IPV4_NAPT=y
CONFIG_LWIP_DHCPS_ADD_DNS=y
CONFIG_MBEDTLS_CERTIFICATE_BUNDLE=y
CONFIG_MBEDTLS_PEM_WRITE_C=y
CONFIG_MBEDTLS_ECP_DP_SECP256R1_ENABLED=y
CONFIG_ESP_MAIN_TASK_STACK_SIZE=8192
CONFIG_ESP_CONSOLE_UART_DEFAULT=y
CONFIG_ESP_CONSOLE_USB_SERIAL_JTAG=n
CONFIG_ESP_TASK_WDT_TIMEOUT_S=10
CONFIG_COMPILER_OPTIMIZATION_SIZE=y
```

## src/platform/esp32/Kconfig.projbuild
```kconfig
menu "KhiCAS USB AI bridge"
config BRIDGE_QEMU
    bool "Use two QEMU OpenCores Ethernet interfaces instead of Wi-Fi"
    default n
config BRIDGE_VBUS_GPIO
    int "External active-high USB VBUS switch GPIO (-1: externally powered)"
    range -1 48
    default -1
endmenu
```
